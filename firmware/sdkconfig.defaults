## firmware/sdkconfig.defaults
```kconfig
CONFIG_IDF_TARGET="esp32s3"
CONFIG_ESPTOOLPY_FLASHSIZE_16MB=y
CONFIG_ESPTOOLPY_FLASHMODE_QIO=y
CONFIG_PARTITION_TABLE_SINGLE_APP=y
CONFIG_ESP_DEFAULT_CPU_FREQ_MHZ_240=y
CONFIG_FREERTOS_HZ=1000

# Stage-2 transport rule:
# UART0 is reserved for the IMU. Application console / log / CLI stay on USB CDC only.
# CONFIG_ESP_CONSOLE_UART_DEFAULT is not set
CONFIG_ESP_CONSOLE_USB_CDC=y
# CONFIG_ESP_CONSOLE_UART_CUSTOM is not set
CONFIG_ESP_CONSOLE_SECONDARY_NONE=y
# CONFIG_ESP_CONSOLE_UART is not set
# CONFIG_ESP_CONSOLE_USB_SERIAL_JTAG is not set
CONFIG_ESP_CONSOLE_UART_NUM=-1
CONFIG_ESP_CONSOLE_ROM_SERIAL_PORT_NUM=3
CONFIG_ESP_CONSOLE_USB_CDC_RX_BUF_SIZE=64
# CONFIG_ESP_CONSOLE_USB_CDC_SUPPORT_ETS_PRINTF is not set
CONFIG_ESP_SYSTEM_PANIC_PRINT_REBOOT=y
CONFIG_LOG_DEFAULT_LEVEL_WARN=y
CONFIG_SPIRAM=y
CONFIG_SPIRAM_MODE_OCT=y
CONFIG_SPIRAM_SPEED_80M=y
CONFIG_NVS_ENCRYPTION=n
```
